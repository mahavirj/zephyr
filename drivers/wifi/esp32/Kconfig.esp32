## drivers/wifi/esp32/Kconfig.esp32
```kconfig
# Copyright 2020 Espressif Systems (Shanghai) PTE LTD

menuconfig WIFI_ESP32
	bool "Espressif ESP32 support"
	default n

if WIFI_ESP32

config WIFI_SSID
	string "SSID of WiFi network"
	default "myssid"
	help
		SSID (network name) for the application to connect to

config WIFI_PASSWORD
	string "Password (WPA or WPA2) of WiFi network"
	default "mypassword"
	help
		WiFi password (WPA or WPA2) for the example to use.

config EVENT_TASK_STACK_SIZE
	int "Event Task Stack Size"
	default 4096

config EVENT_TASK_PRIO
	int "Event Task Priority"
	default 4

endif # WIFI_ESP32
```
