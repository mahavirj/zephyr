## prj.conf
```kconfig
CONFIG_INIT_STACKS=y
CONFIG_HEAP_MEM_POOL_SIZE=65536
CONFIG_HEAP_MEM_POOL_MIN_SIZE=32000
CONFIG_POSIX_API=y
CONFIG_PTHREAD_IPC=y
CONFIG_POSIX_MQUEUE=y
CONFIG_DYNAMIC_INTERRUPTS=y
CONFIG_MBEDTLS=y
CONFIG_NETWORKING=y
CONFIG_WIFI=y
CONFIG_WIFI_ESP32=y

CONFIG_MBEDTLS_ENTROPY_ENABLED=y
CONFIG_MBEDTLS_KEY_EXCHANGE_ECDHE_ECDSA_ENABLED=y
CONFIG_MBEDTLS_ECP_ALL_ENABLED=y
```

## src/main.c
```c
/*
 * Copyright (c) 2012-2014 Wind River Systems, Inc.
 *
 * SPDX-License-Identifier: Apache-2.0
 */

#include <zephyr.h>
#include <sys/printk.h>
#include "esp_wifi.h"
#include "esp_timer.h"
#include "esp_wpa.h"

void main(void)
{
    esp_timer_init();
    esp_event_init();
    wifi_init_config_t config = WIFI_INIT_CONFIG_DEFAULT();
    esp_err_t ret = esp_wifi_init(&config);

    ret |= esp_supplicant_init();
    ret |= esp_wifi_start();
    ret |= esp_wifi_set_mode(WIFI_MODE_STA);
    wifi_config_t wifi_config = {
	.sta = {
	    .ssid = "myssid",
	    .password = "mypassword",
	    /* Setting a password implies station will connect to all security modes including WEP/WPA.
	     * However these modes are deprecated and not advisable to be used. Incase your Access point
	     * doesn't support WPA2, these mode can be enabled by commenting below line */
	    .threshold.authmode = WIFI_AUTH_WPA2_PSK,
	},
    };
    ret |= esp_wifi_set_config(ESP_IF_WIFI_STA, &wifi_config);
    if (ret != ESP_OK) {
	printk("WiFi Init Failed\n");
    }
}
```
